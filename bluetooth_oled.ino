#include <SPI.h>
#include <Wire.h>
#include <SoftwareSerial.h>
#include <Adafruit_GFX.h>
#include <Adafruit_SSD1306.h>

#define SCREEN_WIDTH 128 // OLED display width, en pixels
#define SCREEN_HEIGHT 64 // OLED display height, en pixels
#define OLED_RESET -1 // Reset pin 

Adafruit_SSD1306 display(SCREEN_WIDTH, SCREEN_HEIGHT, &Wire, OLED_RESET);

#define NUMFLAKES     10 // numero de  snowflakes 

#define LOGO_HEIGHT   64
#define LOGO_WIDTH    128
#define NUM_SAMPLES 10

 String data="";
static const unsigned char PROGMEM logo_bmp[] =
{ 0x00, 0x00, 0x00, 0x00, 0x00, 0x00, 0x00, 0x00, 0x00, 0x00, 0x00, 0x00, 0x00, 0x00, 0x00, 0x00,
0x00, 0x00, 0x00, 0x00, 0x00, 0x00, 0x00, 0x00, 0x00, 0x00, 0x00, 0x00, 0x00, 0x00, 0x00, 0x00,
0x00, 0x00, 0x00, 0x00, 0x00, 0x00, 0x00, 0x00, 0x00, 0x00, 0x00, 0x00, 0x00, 0x00, 0x00, 0x00,
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0x00, 0x00, 0x00, 0x00, 0x00, 0x00, 0x00, 0x00, 0x00, 0x00, 0x00, 0x00, 0x00, 0x00, 0x00, 0x00
 };


int sum = 0;                   
unsigned char sample_count = 0; 
float voltage = 0.0;            

void setup()
{
  
   Serial.begin(9600);
   if(!display.begin(SSD1306_SWITCHCAPVCC, 0x3C)) { 
    Serial.println(F("Display Error"));
    for(;;); 
  }
  
  display.display();
  delay(2000); 
  
  
  display.clearDisplay();

  
  display.drawPixel(10, 10, WHITE);

  
  display.display();
  delay(1000);
 
  testdrawbitmap();
  delay(2000);
  display.clearDisplay() ;
}

void testdrawbitmap(void) {
  display.clearDisplay();

  display.drawBitmap(
    (display.width()  - LOGO_WIDTH ) / 128,
    (display.height() - LOGO_HEIGHT) / 64,
    logo_bmp, LOGO_WIDTH, LOGO_HEIGHT, 2);
  display.display();
  delay(1000);
}


void loop() 
{
  
  data="";
  display.clearDisplay();
  if(Serial.available() > 0) 
  {
    //while(Serial.available() > 0)
    Serial.print("Incoming_value");        
    Serial.print("\n");     
    data=Serial.readString();
    if(data==String("+DISC:SUCCESS OK"))
    {
        data="desconetado";
    }
    if(data.equals(String("+DISC:SUCCESS OK")))
    {
        data="desconetado";
    }
    if(data.equalsIgnoreCase(String("+DISC:SUCCESS OK")))
    {
        data="desconetado";
    }
    display.setTextSize(2);
    display.setTextColor(WHITE);
    display.setCursor(0,0);
    //display.setCursor(0, 0);
    //Display static text
    display.println(data);
    display.display();
    delay(2000);
   data="";
   display.clearDisplay();
  }
  else   if(Serial.available() < 0) 

  {
     display.clearDisplay();
  }
}
